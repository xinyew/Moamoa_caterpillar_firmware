## Boards/kamoamoa/caterpillar/Kconfig.caterpillar
```kconfig
config BOARD_CATERPILLAR
	select SOC_NRF54L15_CPUAPP if BOARD_CATERPILLAR_NRF54L15_CPUAPP
	select SOC_NRF54L15_CPUFLPR if BOARD_CATERPILLAR_NRF54L15_CPUFLPR
```

## Boards/kamoamoa/caterpillar/Kconfig.defconfig
```kconfig
config HW_STACK_PROTECTION
	default ARCH_HAS_STACK_PROTECTION

if SPI_NOR

config SPI_NOR_FLASH_LAYOUT_PAGE_SIZE
	default 4096 if MCUBOOT || BOOTLOADER_MCUBOOT

endif # SPI_NOR
```

## Boards/kamoamoa/caterpillar/board.yml
```yaml
board:
  name: caterpillar
  full_name: Caterpillar Untethering Board
  vendor: kamoamoa
  socs:
    - name: nrf54l15

runners:
  run_once:
    '--recover':
      - runners:
          - nrfutil
        run: first
        groups:
          - boards:
              - caterpillar/nrf54l15/cpuapp
              - caterpillar/nrf54l15/cpuflpr
    '--erase':
      - runners:
          - jlink
          - nrfutil
        run: first
        groups:
          - boards:
              - caterpillar/nrf54l15/cpuapp
              - caterpillar/nrf54l15/cpuflpr
    '--reset':
      - runners:
          - jlink
          - nrfutil
        run: last
        groups:
          - boards:
              - caterpillar/nrf54l15/cpuapp
              - caterpillar/nrf54l15/cpuflpr
```

## Boards/kamoamoa/caterpillar/caterpillar_nrf54l15_cpuapp_defconfig
```kconfig
# Enable GPIO and MPU
CONFIG_GPIO=y
CONFIG_ARM_MPU=y

# Subsystem defaults for Caterpillar Hardware
CONFIG_I2C=y
CONFIG_PWM=y

# Disable UART, Enable Segger RTT for Debug
CONFIG_SERIAL=n
CONFIG_USE_SEGGER_RTT=y
CONFIG_RTT_CONSOLE=y
```

## Boards/kamoamoa/caterpillar/caterpillar_nrf54l15_cpuflpr_defconfig
```kconfig
# Enable GPIO
CONFIG_GPIO=y

# Memory Execution (Run from RAM)
CONFIG_USE_DT_CODE_PARTITION=y
CONFIG_XIP=n

# Disable UART, Enable Segger RTT for Debug
CONFIG_SERIAL=n
CONFIG_CONSOLE=y
CONFIG_USE_SEGGER_RTT=y
CONFIG_RTT_CONSOLE=y

# no lfxo on this board
CONFIG_CLOCK_CONTROL_NRF_K32SRC_RC=y
CONFIG_CLOCK_CONTROL_NRF_K32SRC_XTAL=n
```

## boards/kamoamoa/caterpillar/caterpillar_nrf54l15_cpuapp_defconfig
```kconfig
# Enable GPIO and MPU
CONFIG_GPIO=y
CONFIG_ARM_MPU=y

# Subsystem defaults for Caterpillar Hardware
CONFIG_I2C=y
CONFIG_PWM=y

# Disable UART, Enable Segger RTT for Debug
CONFIG_SERIAL=n
CONFIG_USE_SEGGER_RTT=y
CONFIG_RTT_CONSOLE=y

# no lfxo on this board
CONFIG_CLOCK_CONTROL_NRF_K32SRC_RC=y
CONFIG_CLOCK_CONTROL_NRF_K32SRC_XTAL=n
```

## boards/kamoamoa/caterpillar/caterpillar_nrf54l15_cpuflpr_defconfig
```kconfig
# Enable GPIO
CONFIG_GPIO=y

# Memory Execution (Run from RAM)
CONFIG_USE_DT_CODE_PARTITION=y
CONFIG_XIP=n

# Headless coprocessor: no UART on this board, no console at all.
# (Do NOT enable clock-control LFCLK options here - the app core's
# radio stack owns the CLOCK peripheral; the FLPR must not touch it.)
CONFIG_SERIAL=n
CONFIG_CONSOLE=n
```
