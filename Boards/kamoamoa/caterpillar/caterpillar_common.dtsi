#include "caterpillar_nrf54l15-pinctrl.dtsi"

/ {
	aliases {
		watchdog0 = &wdt31;
	};
};

&i2c20 {
	status = "okay";
	pinctrl-0 = <&i2c20_default>;
	pinctrl-1 = <&i2c20_sleep>;
	pinctrl-names = "default", "sleep";
};

&pwm20 {
	status = "okay";
	pinctrl-0 = <&pwm20_default>;
	pinctrl-1 = <&pwm20_sleep>;
	pinctrl-names = "default", "sleep";
};